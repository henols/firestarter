/*
 * Project Name: Firestarter
 * Copyright (c) 2024 Henrik Olsson
 *
 * Permission is hereby granted under MIT license.
 *
 * Phase 52 Plan 02 / Phase 54 Plan 01 — Firmware Unity vector suite.
 *
 * Asserts both legs of the COBS frame contract against the frozen golden
 * vectors generated in Plan 01 (firestarter/include/frame_vectors.h):
 *
 *   Leg 1 (encode):  build_cobs_frame_bytes(vec.payload) == vec.frame
 *   Leg 2a (decode, CMD_IDLE cap):  rurp_communication_read_data(vec.frame,
 *       DATA_BUFFER_SIZE - 1) == vec.payload  (skips 512/1024-byte vectors)
 *   Leg 2b (decode, MAIN path cap): rurp_communication_read_data(vec.frame,
 *       DATA_BUFFER_SIZE) == vec.payload  (ALL vectors, no skip guard for
 *       full-buffer payloads — EVEN-01 SC1/SC4 proof)
 *
 * A CRC8 known-answer test (D-06/SC4) pins poly 0x07 / seed 0x00
 * independently of the production CRC8_TABLE PROGMEM array.
 *
 * Phase 54 additions (EVEN-01):
 *   test_vector_decode_leg_main_path — MAIN-path cap=DATA_BUFFER_SIZE decode
 *       for ALL vectors including 512/1024-byte ones (SC1/SC4).
 *   test_cmd_idle_overflow_at_full_block — CMD_IDLE cap=DATA_BUFFER_SIZE-1
 *       rejects 512-byte payload (returns < 0); pins CR-01 regression guard.
 *   test_even_block_no_remainder — arithmetic assertion: 65536 % DATA_BUFFER_SIZE
 *       == 0 (no remainder chunk for a full 64 KB chip; EVEN-01 SC2).
 *
 * Mirrors the structure of test_cobs_cmd_frame.cpp (Phase 51 Plan 01).
 * Uses serial_read_mock.h for the decode leg (finite-stream semantics).
 *
 * Requirements pinned: LOCK-01, LOCK-02 (SC2/SC4), EVEN-01 (SC1/SC2/SC4).
 */

#include <Arduino.h>
#include <ArduinoFake.h>
#include <unity.h>

#include <cstdint>
#include <cstddef>
#include <cstring>
#include <vector>

/* Shared mock helper — wires Serial.read/available/peek to a queued vector. */
#include "serial_read_mock.h"

extern "C" {
#include "rurp_shield.h"
#include "firestarter.h"
}

/* Golden-vector PROGMEM catalog (generated by tools/catalog/codegen_vectors.py). */
#include "frame_vectors.h"

using namespace fakeit;

/* ------------------------------------------------------------------------ */
/* Shared test state                                                         */
/* ------------------------------------------------------------------------ */

static char data_buffer[DATA_BUFFER_SIZE];
static std::vector<uint8_t> rx_queue;
static size_t rx_pos;

/* ------------------------------------------------------------------------ */
/* Reference CRC8 (poly 0x07, seed 0x00, no refl, no XOR) — table-free.    */
/* Copied verbatim from test_cobs_cmd_frame.cpp so this suite is fully      */
/* independent of the production CRC8_TABLE in rurp_serial_utils.cpp.       */
/* ------------------------------------------------------------------------ */
static uint8_t ref_crc8(const uint8_t* data, size_t n) {
    uint8_t crc = 0;
    for (size_t i = 0; i < n; i++) {
        crc ^= data[i];
        for (int k = 0; k < 8; k++) {
            crc = (crc & 0x80)
                      ? (uint8_t)((crc << 1) ^ 0x07)
                      : (uint8_t)(crc << 1);
        }
    }
    return crc;
}

/* ------------------------------------------------------------------------ */
/* COBS encode helper — test-side only, used to build expected byte streams. */
/*                                                                           */
/* Encodes `src[0..len-1]` into `dst`, returns encoded byte count (without  */
/* the trailing 0x00 delimiter — caller appends it).                        */
/*                                                                           */
/* Standard COBS: scan for 0x00 or end of run (<=254 non-zero bytes), emit */
/* run-code byte (run_len+1), then the non-zero bytes.  A 0x00 payload byte */
/* emits a run-code of 1 with no data bytes.  A 254-run code byte is 0xFF   */
/* (no implicit zero follows it per RFC COBS).                               */
/*                                                                           */
/* Copied verbatim from test_cobs_cmd_frame.cpp.                             */
/* ------------------------------------------------------------------------ */
static size_t test_cobs_encode(const uint8_t* src, size_t len, uint8_t* dst) {
    size_t out = 0;
    size_t code_pos = out++;        /* placeholder for first run-code */
    uint8_t code = 1;               /* run_len + 1 */

    for (size_t i = 0; i < len; i++) {
        if (src[i] == 0x00) {
            dst[code_pos] = code;
            code_pos = out++;
            code = 1;
        } else {
            dst[out++] = src[i];
            code++;
            if (code == 0xFF) {
                /* 254-run boundary: emit now, start new run without zero */
                dst[code_pos] = code;
                code_pos = out++;
                code = 1;
            }
        }
    }
    dst[code_pos] = code;
    return out;
}

/* Build the COBS frame byte sequence (no '#' preamble for command frames) into
 * `out_vec`:
 *   COBS(payload + CRC8(payload)) + 0x00
 * This is what rurp_communication_read_data() receives on the command channel.
 * Copied verbatim from test_cobs_cmd_frame.cpp. */
static void build_cobs_frame_bytes(
    const uint8_t* payload, size_t payload_len,
    std::vector<uint8_t>& out_vec
) {
    uint8_t crc = ref_crc8(payload, payload_len);

    /* Logical stream = payload + crc byte */
    std::vector<uint8_t> src(payload, payload + payload_len);
    src.push_back(crc);

    /* COBS-encode: max encoded size = len + len/254 + 1 */
    size_t max_enc = src.size() + src.size() / 254 + 2;
    std::vector<uint8_t> encoded(max_enc);
    size_t enc_len = test_cobs_encode(src.data(), src.size(), encoded.data());

    out_vec.insert(out_vec.end(), encoded.data(), encoded.data() + enc_len);
    out_vec.push_back(0x00);  /* frame delimiter */
}

/* ------------------------------------------------------------------------ */
/* setUp / tearDown                                                          */
/* ------------------------------------------------------------------------ */

static unsigned long millis_counter;

void setUp(void) {
    ArduinoFakeReset();
    rx_queue.clear();
    rx_pos = 0;
    millis_counter = 0;
    memset(data_buffer, 0, sizeof(data_buffer));

    /* Stub flush() so ArduinoFake doesn't warn. */
    When(Method(ArduinoFake(Serial), flush)).AlwaysReturn();

    /* Stub write so ArduinoFake doesn't complain if the decode path ever
     * triggers an error log that touches Serial.write (shouldn't, but safe). */
    When(OverloadedMethod(ArduinoFake(Serial), write, size_t(uint8_t)))
        .AlwaysReturn((size_t)1);

    /* millis() — monotonically increasing counter.  The COBS decoder does
     * NOT have a wall-clock timeout loop (the 2 s cascade was deleted in
     * Phase 50 — SC1 win).  This stub is retained for defensive
     * completeness in case any helper path ever calls millis(). */
    When(Method(ArduinoFake(Function), millis))
        .AlwaysDo([&]() -> unsigned long {
            millis_counter += 100;
            return millis_counter;
        });
}

void tearDown(void) {
}

/* ------------------------------------------------------------------------ */
/* test_crc8_known_answer (D-06 / SC4)                                      */
/*                                                                           */
/* Pins CRC8 poly 0x07, seed 0x00 independently of the production           */
/* CRC8_TABLE PROGMEM array in rurp_serial_utils.cpp.                       */
/*                                                                           */
/* Known values:                                                             */
/*   ref_crc8([0x01], 1) == 0x07  — CRC8 of 0x01 is the polynomial itself  */
/*   ref_crc8(NULL,   0) == 0x00  — empty payload returns seed              */
/* ------------------------------------------------------------------------ */
void test_crc8_known_answer(void) {
    const uint8_t input[] = { 0x01 };
    TEST_ASSERT_EQUAL_HEX8(0x07, ref_crc8(input, 1));
    TEST_ASSERT_EQUAL_HEX8(0x00, ref_crc8(NULL, 0));
}

/* ------------------------------------------------------------------------ */
/* test_vector_encode_leg (LOCK-01, leg 1)                                  */
/*                                                                           */
/* For every golden vector in FRAME_VECTORS (including 512/1024-byte ones): */
/*   build_cobs_frame_bytes(vec.payload, vec.payload_len) == vec.frame      */
/*                                                                           */
/* The encoder has no cap — all vectors exercise the encode leg.            */
/* ------------------------------------------------------------------------ */
void test_vector_encode_leg(void) {
    for (uint16_t i = 0; i < FRAME_VECTOR_COUNT; i++) {
        /* Read vector from PROGMEM into a local copy. */
        frame_vector_t vec;
        memcpy_P(&vec, &FRAME_VECTORS[i], sizeof(frame_vector_t));

        /* Build the expected frame bytes using the test-side encoder. */
        std::vector<uint8_t> built;
        build_cobs_frame_bytes(vec.payload, vec.payload_len, built);

        /* Assert byte-for-byte match against the frozen frame bytes. */
        TEST_ASSERT_EQUAL_size_t(vec.frame_len, built.size());
        TEST_ASSERT_EQUAL_MEMORY(vec.frame, built.data(), vec.frame_len);
    }
}

/* ------------------------------------------------------------------------ */
/* test_vector_decode_leg (LOCK-01, leg 2 — CMD_IDLE path)                  */
/*                                                                           */
/* For each golden vector with payload_len <= DATA_BUFFER_SIZE - 1 (511 B): */
/*   rurp_communication_read_data(vec.frame, DATA_BUFFER_SIZE - 1) returns  */
/*   vec.payload_len and data_buffer matches vec.payload byte-for-byte.     */
/*                                                                           */
/* Cap = DATA_BUFFER_SIZE - 1 (CMD_IDLE path; CR-01 NUL-slot reserved).    */
/* Vectors with payload_len > DATA_BUFFER_SIZE - 1 are skipped here —      */
/* they test the MAIN path (cap = DATA_BUFFER_SIZE) in                      */
/* test_vector_decode_leg_main_path below (Pitfall 4 / Phase 54 D-07).     */
/* ------------------------------------------------------------------------ */
void test_vector_decode_leg(void) {
    for (uint16_t i = 0; i < FRAME_VECTOR_COUNT; i++) {
        /* Read vector from PROGMEM into a local copy. */
        frame_vector_t vec;
        memcpy_P(&vec, &FRAME_VECTORS[i], sizeof(frame_vector_t));

        /* Skip vectors that exceed the CMD_IDLE cap (DATA_BUFFER_SIZE - 1).
         * Those vectors decode on the MAIN path (test_vector_decode_leg_main_path). */
        if (vec.payload_len > DATA_BUFFER_SIZE - 1) {
            continue;
        }

        /* Load the frozen frame bytes into the rx_queue mock. */
        rx_queue.clear();
        rx_pos = 0;
        rx_queue.insert(rx_queue.end(), vec.frame, vec.frame + vec.frame_len);
        setup_serial_read_mock(rx_queue, rx_pos);

        /* Reset the output buffer for each vector. */
        memset(data_buffer, 0, sizeof(data_buffer));

        /* Decode with CMD_IDLE cap (DATA_BUFFER_SIZE - 1). */
        int res = rurp_communication_read_data(data_buffer, DATA_BUFFER_SIZE - 1);

        /* Must return a non-negative result. */
        TEST_ASSERT_GREATER_OR_EQUAL_INT(0, res);
        /* Must return the exact payload length. */
        TEST_ASSERT_EQUAL_size_t(vec.payload_len, (size_t)res);
        /* Decoded bytes must match the original payload (skip if empty —
         * Unity treats TEST_ASSERT_EQUAL_MEMORY with size=0 as an error). */
        if (vec.payload_len > 0) {
            TEST_ASSERT_EQUAL_MEMORY(vec.payload, data_buffer, vec.payload_len);
        }
    }
}

/* ------------------------------------------------------------------------ */
/* test_vector_decode_leg_main_path (EVEN-01 SC1/SC4 — MAIN data path)     */
/*                                                                           */
/* For all golden vectors with payload_len <= DATA_BUFFER_SIZE (including   */
/* the DATA_BUFFER_SIZE-byte full-buffer vectors):                           */
/*   rurp_communication_read_data(vec.frame, DATA_BUFFER_SIZE) returns      */
/*   vec.payload_len and data_buffer matches vec.payload byte-for-byte.     */
/*                                                                           */
/* Cap = DATA_BUFFER_SIZE (MAIN/write-receive path — Phase 54 Candidate A). */
/* Full-buffer vectors (payload_len == DATA_BUFFER_SIZE) are the key case:  */
/* they decode successfully at this cap, proving EVEN-01 SC1/SC4.           */
/* Proves: cobs_encode(DATA_BUFFER_SIZE bytes + CRC8) → decoder(cap=        */
/* DATA_BUFFER_SIZE) → original DATA_BUFFER_SIZE bytes (round-trip SC4).   */
/* data_buffer[] consumed by index only on this path; no NUL write; safe   */
/* per RESEARCH D-01 source trace.                                           */
/*                                                                           */
/* Note: vectors with payload_len > DATA_BUFFER_SIZE (e.g. Leonardo 1024-  */
/* byte vectors when built in Uno native mode) are skipped here because     */
/* the static data_buffer is exactly DATA_BUFFER_SIZE bytes — they test a  */
/* board-specific scenario outside the native test env's buffer capacity.  */
/* ------------------------------------------------------------------------ */
void test_vector_decode_leg_main_path(void) {
    for (uint16_t i = 0; i < FRAME_VECTOR_COUNT; i++) {
        /* Read vector from PROGMEM into a local copy. */
        frame_vector_t vec;
        memcpy_P(&vec, &FRAME_VECTORS[i], sizeof(frame_vector_t));

        /* Skip vectors whose payload exceeds this env's DATA_BUFFER_SIZE
         * (e.g. 1024-byte Leonardo vectors when DATA_BUFFER_SIZE = 512). */
        if (vec.payload_len > DATA_BUFFER_SIZE) {
            continue;
        }

        /* Load the frozen frame bytes into the rx_queue mock. */
        rx_queue.clear();
        rx_pos = 0;
        rx_queue.insert(rx_queue.end(), vec.frame, vec.frame + vec.frame_len);
        setup_serial_read_mock(rx_queue, rx_pos);

        /* Reset the output buffer for each vector. */
        memset(data_buffer, 0, sizeof(data_buffer));

        /* Decode with MAIN-path cap (DATA_BUFFER_SIZE — full even block).
         * Key assertion: 512-byte payloads decode successfully (no -2 overflow). */
        int res = rurp_communication_read_data(data_buffer, DATA_BUFFER_SIZE);

        /* Must return a non-negative result (including the DATA_BUFFER_SIZE-byte vectors). */
        TEST_ASSERT_GREATER_OR_EQUAL_INT(0, res);
        /* Must return the exact payload length. */
        TEST_ASSERT_EQUAL_size_t(vec.payload_len, (size_t)res);
        /* Decoded bytes must match the original payload. */
        if (vec.payload_len > 0) {
            TEST_ASSERT_EQUAL_MEMORY(vec.payload, data_buffer, vec.payload_len);
        }
    }
}

/* ------------------------------------------------------------------------ */
/* test_cmd_idle_overflow_at_full_block (CR-01 regression guard — Pitfall 1)*/
/*                                                                           */
/* Feed the VEC_512_ALL_FF frame (512-byte payload, 517-byte frame) to the  */
/* decoder with CMD_IDLE cap (DATA_BUFFER_SIZE - 1 = 511).                  */
/* Assert return value < 0 (overflow, -2).                                  */
/*                                                                           */
/* This pins the CR-01 NUL-slot reservation on the command path: a 512-byte */
/* payload MUST overflow the CMD_IDLE decoder — if this test regresses to   */
/* passing (returning > 0), the caller's data_buffer[n] = '\0' write would  */
/* be an OOB write at data_buffer[512] (into handle.data_size — T-54-02).  */
/* Guards Pitfall 1: "Forgetting the CMD_IDLE Cap".                         */
/* ------------------------------------------------------------------------ */
void test_cmd_idle_overflow_at_full_block(void) {
    /* Find VEC_512_ALL_FF in the golden-vector catalog (id = 0x09). */
    frame_vector_t vec512;
    bool found = false;
    for (uint16_t i = 0; i < FRAME_VECTOR_COUNT; i++) {
        frame_vector_t v;
        memcpy_P(&v, &FRAME_VECTORS[i], sizeof(frame_vector_t));
        if (v.payload_len == DATA_BUFFER_SIZE) {
            memcpy(&vec512, &v, sizeof(frame_vector_t));
            found = true;
            break;
        }
    }
    /* If no 512-byte vector exists in the catalog, this guard cannot fire. */
    TEST_ASSERT_TRUE_MESSAGE(found, "No DATA_BUFFER_SIZE-byte vector in catalog");

    /* Load the VEC_512_ALL_FF frame bytes into the rx_queue mock. */
    rx_queue.clear();
    rx_pos = 0;
    rx_queue.insert(rx_queue.end(), vec512.frame, vec512.frame + vec512.frame_len);
    setup_serial_read_mock(rx_queue, rx_pos);

    memset(data_buffer, 0, sizeof(data_buffer));

    /* Decode with CMD_IDLE cap (DATA_BUFFER_SIZE - 1): must overflow. */
    int res = rurp_communication_read_data(data_buffer, DATA_BUFFER_SIZE - 1);

    /* Must return a negative value (-2 overflow). CR-01 invariant pinned. */
    TEST_ASSERT_LESS_THAN_INT(0, res);
}

/* ------------------------------------------------------------------------ */
/* test_even_block_no_remainder (EVEN-01 SC2 — no remainder chunk)          */
/*                                                                           */
/* Pure arithmetic assertion: 65536 (a full 64 KB chip) divides exactly     */
/* into DATA_BUFFER_SIZE blocks with zero remainder.                        */
/* 65536 % 512 == 0 → 128 × 512 = 65536 exactly, no partial last chunk.    */
/* (Also true for 1024: 65536 % 1024 == 0 → 64 × 1024 = 65536.)           */
/* No mock needed.                                                           */
/* ------------------------------------------------------------------------ */
void test_even_block_no_remainder(void) {
    TEST_ASSERT_EQUAL_UINT32(0, (uint32_t)(65536 % DATA_BUFFER_SIZE));
}

/* ------------------------------------------------------------------------ */
/* main                                                                      */
/* ------------------------------------------------------------------------ */
int main(int argc, char** argv) {
    (void)argc;
    (void)argv;
    UNITY_BEGIN();

    RUN_TEST(test_crc8_known_answer);
    RUN_TEST(test_vector_encode_leg);
    RUN_TEST(test_vector_decode_leg);
    RUN_TEST(test_vector_decode_leg_main_path);
    RUN_TEST(test_cmd_idle_overflow_at_full_block);
    RUN_TEST(test_even_block_no_remainder);

    return UNITY_END();
}
